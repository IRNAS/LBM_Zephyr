## drivers/lora_lbm/Kconfig
```kconfig
# LoRa Basics Modem drivers configuration options
#
# Copyright (c) 2024 Semtech Corporation - Félix Piédallu
#
# SPDX-License-Identifier: Apache-2.0

#FIXME: Might be renamed LORA_DRIVERS
menuconfig LORA_BASICS_MODEM_DRIVERS
	bool "LoRa drivers from the new LoRa Basics Modem stack [EXPERIMENTAL]"
	select POLL
	select EXPERIMENTAL
	select ZEPHYR_LORA_BASICS_MODEM_MODULE
	depends on !LORA
	help
	  Include LoRa drivers from the new LoRa Basics Modem stack in the system configuration.

if LORA_BASICS_MODEM_DRIVERS

module = LORA_BASICS_MODEM_DRIVERS
module-str = lora-lbm
source "subsys/logging/Kconfig.template.log_config"

rsource "Kconfig.lr11xx"
rsource "Kconfig.sx12xx"

config LORA_BASICS_MODEM_DRIVERS_INIT_PRIORITY
  int "Init priority"
  default 50


config LORA_BASICS_MODEM_DRIVERS_EVENT_TRIGGER
	bool

choice
	prompt "Event trigger mode"
	default LORA_BASICS_MODEM_DRIVERS_EVENT_TRIGGER_GLOBAL_THREAD
	help
	  Specify the type of triggering to be used by the LORA_BASICS_MODEM_DRIVERS driver.

config LORA_BASICS_MODEM_DRIVERS_EVENT_TRIGGER_NONE
	bool "No trigger on event"

config LORA_BASICS_MODEM_DRIVERS_EVENT_TRIGGER_GLOBAL_THREAD
	bool "Use global thread"
	depends on GPIO
	select LORA_BASICS_MODEM_DRIVERS_EVENT_TRIGGER

config LORA_BASICS_MODEM_DRIVERS_EVENT_TRIGGER_OWN_THREAD
	bool "Use own thread"
	depends on GPIO
	select LORA_BASICS_MODEM_DRIVERS_EVENT_TRIGGER

config LORA_BASICS_MODEM_DRIVERS_EVENT_TRIGGER_DIRECT
	bool "Call handler directly from ISR"
	depends on GPIO
	select LORA_BASICS_MODEM_DRIVERS_EVENT_TRIGGER

endchoice # LORA_BASICS_MODEM_DRIVERS_EVENT_TRIGGER

choice
	prompt "Event trigger type"
	default LORA_BASICS_MODEM_DRIVERS_EVENT_TRIGGER_TYPE_EDGE_TO
	help
	  Specify the type of triggering to be used by the LORA_BASICS_MODEM_DRIVERS driver - edge to active/inactive or level active/inactive based.
	  Driver operation will remain unchanged. There is a difference in power consumption of ~20 uA extra when using edge_to trigger.
	  If LORA_BASICS_MODEM_DRIVERS_EVENT_TRIGGER_NONE is selected, set this to LORA_BASICS_MODEM_DRIVERS_EVENT_TRIGGER_TYPE_NONE.

config LORA_BASICS_MODEM_DRIVERS_EVENT_TRIGGER_TYPE_NONE
	bool "No trigger type"
	help
	  No trigger type is used, the driver will not use any event trigger. Should be set if LORA_BASICS_MODEM_DRIVERS_EVENT_TRIGGER_NONE is selected.

config LORA_BASICS_MODEM_DRIVERS_EVENT_TRIGGER_TYPE_EDGE_TO
	bool "Edge to active / inactive trigger"
	depends on LORA_BASICS_MODEM_DRIVERS_EVENT_TRIGGER

config LORA_BASICS_MODEM_DRIVERS_EVENT_TRIGGER_TYPE_LEVEL
	bool "Level active/inactive trigger"
	depends on LORA_BASICS_MODEM_DRIVERS_EVENT_TRIGGER

endchoice # LORA_BASICS_MODEM_DRIVERS_EVENT_TRIGGER_TYPE

config LORA_BASICS_MODEM_DRIVERS_EVENT_TRIGGER_THREAD_PRIORITY
	int "Thread priority"
	depends on LORA_BASICS_MODEM_DRIVERS_EVENT_TRIGGER_OWN_THREAD
	default 10
	help
	  Priority of thread used by the driver to handle interrupts.

config LORA_BASICS_MODEM_DRIVERS_EVENT_TRIGGER_THREAD_STACK_SIZE
	int "Thread stack size"
	depends on LORA_BASICS_MODEM_DRIVERS_EVENT_TRIGGER_OWN_THREAD
	default 1024
	help
	  Stack size of thread used by the driver to handle interrupts.

config LORA_BASICS_MODEM_DRIVERS_HAL_WAIT_ON_BUSY_TIMEOUT_MSEC
	int "Time to wait on BUSY pin in ms before aborting"
	default 600000
	help
	  Busy pin wait time in milliseconds. As WiFi and GPS scanning can take
	  seconds/minutes, the default is set to 10 minutes.


config LORA_BASICS_MODEM_DRIVERS_RAL_RALF
	bool "LoRa Radio Abstration Layer from the new LoRa Basics Modem stack"
	default y
	help
	  Include the Radio Abstration Layer from the new LoRa Basics Modem stack

# TODO: LORA_SHELL

endif # LORA_BASICS_MODEM_DRIVERS
```

## dts/bindings/lora_lbm/semtech,sx1280-new.yaml
```yaml
# Copyright (c) 2024 Semtech Corporation
# SPDX-License-Identifier: Apache-2.0

description: Semtech SX1280 LoRa radio module

compatible: "semtech,sx1280-new"

include: semtech,sx128x-new-common.yaml
```

## dts/bindings/lora_lbm/semtech,sx1281-new.yaml
```yaml
# Copyright (c) 2024 Semtech Corporation
# SPDX-License-Identifier: Apache-2.0

description: Semtech SX1281 LoRa radio module

compatible: "semtech,sx1281-new"

include: semtech,sx128x-new-common.yaml
```

## dts/bindings/lora_lbm/semtech,sx128x-new-common.yaml
```yaml
# Copyright (c) 2024 Semtech Corporation
# SPDX-License-Identifier: Apache-2.0

description: Semtech SX128X LoRa radio module

include: spi-device.yaml

properties:
  reset-gpios:
    type: phandle-array
    required: true
    description: |
      GPIO connected to the radio's NRESET signal.

      This signal is open-drain, active-low as interpreted by the modem.

  busy-gpios:
    type: phandle-array
    required: true
    description: |
      GPIO connected to the radio's BUSY signal.

      This signal is high when the radio is ready to accept commands, and
      low when it is processing a command.


  dio1-gpios:
    type: phandle-array
    required: false
    description: |
      GPIO connected to the radio's DIO1 signal. This GPIO will be used as
      a generic IRQ line from the chip.

  dio2-gpios:
    type: phandle-array
    required: false
    description: |
      GPIO connected to the radio's DIO2 signal. This GPIO will be used as
      a generic IRQ line from the chip.

      Note that this conflicts with dio2-as-rf-switch.

  dio3-gpios:
    type: phandle-array
    required: false
    description: |
      GPIO connected to the radio's DIO3 signal. This GPIO will be used as
      a generic IRQ line from the chip.

  reg-mode:
    type: int
    required: true
    enum:
      - 0 # LDO
      - 1 # DCDC
    description: |
      Configuration of the radio's power regulator mode.

      See constants SX128X_REG_MODE_* in dt-bindings/lora_lbm/sx128x.h

  # EvaTODO: left out for now, there is no driver support for setting boosted mode
  #rx-boosted:
  #  type: boolean
  #  description: |
  #    Sets the radio in RX Boosted mode, allowing a ~2dB increased sensitivity,
  #    at the expense of a ~2mA higher current consumption in RX mode.

  tx-power-offset:
    type: int
    required: false
    description: |
      Default board-specific TX Power offset in dB. Defaults to 0.

      Can be reconfigured at runtime via radio_utilities_set_tx_power_offset.
```

## west.yml
```yaml
# Copyright (c) 2024 Semtech Corporation
# SPDX-License-Identifier: Apache-2.0

manifest:
  projects:
    - name: zephyr
      url: https://github.com/zephyrproject-rtos/zephyr
      revision: v3.7.0
      import: true

    - name: lora_basics_modem
      path: modules/lib/lora_basics_modem
      url: https://github.com/IRNAS/SWL2001
      revision: v0.6.0

  self:
    path: application
```
